#include "Queue.h"

#define dly 100

const static byte charmap[95][5] = {{0x00, 0x00, 0x00, 0x00, 0x00}, {0x00, 0x00, 0x7D, 0x00, 0x00}, {0x00, 0x70, 0x00, 0x70, 0x00},//  !"
                                    {0x14, 0x7F, 0x14, 0x7F, 0x14}, {0x12, 0x2A, 0x7F, 0x2A, 0x24}, {0x62, 0x64, 0x08, 0x13, 0x23},// #$%
                                    {0x36, 0x49, 0x35, 0x02, 0x05}, {0x08, 0x70, 0x60, 0x00, 0x00}, {0x00, 0x1C, 0x22, 0x41, 0x00},// &'(
                                    {0x00, 0x41, 0x22, 0x1C, 0x00}, {0x2A, 0x1C, 0x7F, 0x1C, 0x2A}, {0x08, 0x08, 0x7F, 0x08, 0x08},// )*+
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                                    {0x00, 0x41, 0x36, 0x08, 0x00}, {0x20, 0x40, 0x20, 0x10, 0x20}};                               // }~

void setup() {
  Serial.begin(9600);
  for(int i = 2; i >= 9; i++)
  {
    pinMode(i, OUTPUT);
  }
}
byte c = 0;
Queue<char> queue = Queue<char>(512);
void loop() {
  if(queue.count()>0)
  {
    char in=queue.pop();
    Serial.println((char)in);
    c = in - 0x20;
    //Serial.println(c);
    for(int col = 0; col < 5; col++)
    {
      for(int row = 0; row < 7; row++)
      {
        if((charmap[c][col] >> row) & 1)
        {
          Serial.print("*");
          digitalWrite(row+2, HIGH);
        }
        else
        {
          Serial.print(" ");
          digitalWrite(row+2, LOW);
        }
      }
      delay(dly/2);
      Serial.print("\n");
      for(int i = 2; i <= 8; i++)
      {
        digitalWrite(i,LOW);
      }
      digitalWrite(9, HIGH);
      delay(dly/2);
      digitalWrite(9, LOW);
    }
    for(int row = 0; row < 7; row++)
    {
      Serial.print(" ");
      digitalWrite(row+2, LOW);
    }
    delay(dly);
    Serial.print("\n");
    digitalWrite(9, HIGH);
    delay(dly/2);
    digitalWrite(9, LOW);
  }
}

void serialEvent(){
  while(Serial.available())
  {
    char in=Serial.read();
    queue.push(in);
    delayMicroseconds(700);
  }
}


